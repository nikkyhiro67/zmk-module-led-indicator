## Kconfig
```kconfig
menuconfig ZMK_LED_INDICATOR
    bool "ZMK LED Indicator"
    depends on ZMK
    help
      Enable LED indicator module for status display (battery, layer, etc.)

if ZMK_LED_INDICATOR

config ZMK_LED_INDICATOR_THREAD_STACK_SIZE
    int "LED Indicator thread stack size"
    default 1024
    help
      Stack size for LED indicator update thread.

config ZMK_LED_INDICATOR_UPDATE_INTERVAL
    int "LED Indicator update interval (ms)"
    default 2000
    help
      LED indicator refresh interval.

endif
```

## dts/bindings/zmk,led-indicator.yaml
```yaml
description: ZMK LED Indicator module

compatible: "zmk,led-indicator"

include: base.yaml

properties:
  led-strip:
    type: phandle
    required: true
    description: |
      Reference to an LED strip device (e.g. WS2812, SK6812MINI-E).
      This LED will be used to indicate battery level, BLE state, and active layer.

  battery:
    type: phandle
    required: false
    description: |
      Optional reference to a zmk,battery-monitor node.
      Used to display battery level on the LED indicator if available.

  power-gpios:
    type: phandle-array
    required: false
    description: |
      Optional GPIOs for additional indicator LEDs or power control.
      If defined, these GPIOs may be toggled to signal different states.

  status:
    type: string
    required: false
    description: |
      Standard Zephyr device status property.
      Typically "okay" to enable the node.

additionalProperties: false
```
